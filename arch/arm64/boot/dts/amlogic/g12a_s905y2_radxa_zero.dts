#include "g12a_s905y2_2g.dts"

/{
	model = "Radxa Zero";
	coreelec-dt-id = "g12a_s905y2_radxa_zero";

	/delete-node/ memory@00000000;
};

&amhdmitx {
	vend_data {
		vendor_name = "Radxa";
		product_desc = "Zero";
	};
};
