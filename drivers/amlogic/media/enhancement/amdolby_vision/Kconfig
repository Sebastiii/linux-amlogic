## drivers/amlogic/media/enhancement/amdolby_vision/Kconfig
```kconfig
#
# AMLOGIC amdolby_vision devices configuration
#

comment "Amlogic amdolby_vision Drivers"

menu "Amlogic amdolby_vision Driver"

config AMLOGIC_MEDIA_ENHANCEMENT_DOLBYVISION
        bool "Amlogic amdolby_vision driver"
        default n
        help
                "Amlogic amdolby_vision module init"

config AMLOGIC_DV5_COMPAT_SHIM
        tristate "Dolby Vision 5.15 dovi.ko compatibility shim"
        depends on AMLOGIC_MEDIA_ENHANCEMENT_DOLBYVISION
        default n
        help
                Run a 5.15/Android dovi.ko on this 4.9 kernel. Build as module (m).

endmenu
```
